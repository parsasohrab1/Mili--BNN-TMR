## drivers/zephyr/Kconfig
```kconfig
# Mili BNN-TMR Zephyr Driver

config MILI_BNN_TMR
    bool "Mili BNN-TMR accelerator driver"
    depends on SPI
    help
      Enable driver for Mili BNN-TMR edge AI accelerator via SPI.

if MILI_BNN_TMR

module = MILI_BNN_TMR
module-str = mili-bnn-tmr
source "subsys/logging/Kconfig.template.log_config"

endif
```

## drivers/zephyr/dts/bindings/mili,bnn-tmr.yaml
```yaml
description: Mili BNN-TMR BNN accelerator chip

compatible: "mili,bnn-tmr"

include: spi-device.yaml

properties:
  irq-gpios:
    type: phandle-array
    description: Inference-done interrupt GPIO
```
